## arch/arm64/configs/apollo_defconfig
```kconfig
#
#
# Apollo Defconfig
#
#
CONFIG_BOEFFLA_WL_BLOCKER=y
CONFIG_CUSTOM_FORCETOUCH=y
CONFIG_SEC_INPUT_BOOSTER=y
CONFIG_ARGOS=y
CONFIG_ARGOS_CLUSTER_NUM=2
CONFIG_PROC_AVC=y
CONFIG_PAGE_BOOST=y
CONFIG_PAGE_BOOST_RECORDING=y
CONFIG_PROCESS_RECLAIM=y
CONFIG_INCREASE_MAXIMUM_SWAPPINESS=y
CONFIG_KSWAPD_CPU=0x3F

#
# MoroSound
#
CONFIG_MORO_SOUND=y

#
# Flar2 Wake Gestures
#
CONFIG_WAKE_GESTURES=y

#
# Wireguard
#
CONFIG_WIREGUARD=y
# CONFIG_WIREGUARD_DEBUG is not set


#
# Scheduler features
#
# CONFIG_PELT_HALFLIFE_32 is not set
CONFIG_PELT_HALFLIFE_16=y
# CONFIG_PELT_HALFLIFE_8 is not set

#
# IKHEADERS
#
CONFIG_IKHEADERS=y

# Enable power efficient workqueues

#
# Incremental Filesystem
#
CONFIG_INCREMENTAL_FS=y

# KernelSU 32567b: use explicit parent-kernel hooks on Samsung 4.9.
# The dynamic LSM hook-list path is intentionally disabled because it can
# conflict with Samsung RKP before userspace starts.
CONFIG_KSU=y
# CONFIG_KSU_KPROBES_KSUD is not set
# CONFIG_KSU_HACK_ARM64_BRANCH_LINK is not set
# CONFIG_KSU_TAMPER_SYSCALL_TABLE is not set
CONFIG_KSU_FEATURE_SULOG=y
CONFIG_KSU_FEATURE_ADBROOT=y
# CONFIG_KSU_DEBUG is not set
# CONFIG_KSU_LSM_SECURITY_HOOKS is not set
CONFIG_KSU_HEURISTIC_IN_TREE_BUILD=y

# SUSFS v2.2.0 non-GKI bridge controlled by KernelSU.
CONFIG_KSU_SUSFS=y
CONFIG_KSU_SUSFS_SUS_PATH=y
CONFIG_KSU_SUSFS_SUS_MOUNT=y
CONFIG_KSU_SUSFS_SUS_KSTAT=y
CONFIG_KSU_SUSFS_SUS_MAP=y
# CONFIG_KSU_SUSFS_TRY_UMOUNT is not set
CONFIG_KSU_SUSFS_SPOOF_UNAME=y
# CONFIG_KSU_SUSFS_ENABLE_LOG is not set
CONFIG_KSU_SUSFS_HIDE_KSU_SUSFS_SYMBOLS=y
CONFIG_KSU_SUSFS_SPOOF_CMDLINE_OR_BOOTCONFIG=y
CONFIG_KSU_SUSFS_OPEN_REDIRECT=y
# CONFIG_KSU_SUSFS_SUS_MEMFD is not set
```
